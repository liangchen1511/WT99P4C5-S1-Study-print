## components/power_manager/Kconfig.projbuild
```kconfig
menu "Power manager (screen lock)"

config POWER_MANAGER_ENABLE
    bool "Enable automatic screen lock"
    default y

config POWER_MANAGER_IDLE_TIMEOUT_MS
    int "Screen off after idle (ms)"
    default 60000
    range 5000 600000
    depends on POWER_MANAGER_ENABLE

config POWER_MANAGER_TOUCH_POLL_MS
    int "Touch poll interval while screen off (ms)"
    default 200
    range 50 1000
    depends on POWER_MANAGER_ENABLE

endmenu
```

## components/usb_escpos_printer/Kconfig
```kconfig
menu "USB / BLE ESC/POS printer"

    config USB_ESC_POS_CDC_BAUD
        int "USB CDC line baud for ESC/POS (e.g. EM5820H)"
        default 9600
        range 1200 921600
        help
            SET_LINE_CODING baud on the CDC Communication interface.
            EM5820H ships at 9600 8N1; set 115200 if the module was reconfigured.

    config UART_ESC_POS_BAUD
        int "UART TTL ESC/POS baud (Dongwei demo default 115200)"
        default 115200
        range 1200 921600
        help
            8N1, no flow control. Dongwei ESP32-IDF printer SDK demos use 115200.
            EM5820H and some modules ship at 9600 — lower this if the printer is silent.
            Connect ESP32 TX → printer RX, ESP32 RX → printer TX, GND common.
            Self-test via USB does not prove TTL wiring — use the module TTL connector.

    config UART_ESC_POS_SWAP_TX_RX
        bool "Swap TX/RX GPIO (try if printer is silent)"
        default n
        help
            If normal wiring prints nothing, enable and reflash (no need to swap wires).

    config UART_ESC_POS_FLOW_CTS_GPIO
        int "UART CTS GPIO <- printer busy (silkscreen CTS, -1=disable)"
        default 6
        range -1 55
        help
            Printer silkscreen CTS is RTS/busy OUT -> wire to ESP UART CTS input.
            WT99P4C5 J6 IO6 = GPIO6. Enables UART_HW_FLOWCTRL_CTS when >= 0.

    config UART_ESC_POS_BOOT_TEST
        bool "Print Dongwei-style test ticket once after boot"
        default n
        help
            Sends formatted text (demo/1 打印格式化文本) over TTL UART a few seconds after init.

    config UART_ESC_POS_TX_GPIO
        int "UART TX GPIO (to printer RX)"
        range -1 55
        default 4

    config UART_ESC_POS_RX_GPIO
        int "UART RX GPIO (from printer TX)"
        range -1 55
        default 5

    config UART_ESC_POS_PORT
        int "UART controller index (ESP32-P4: use 2 if UART1 pins clash with I2S on GPIO10-13)"
        default 2
        range 0 4
        help
            HP UART port number. UART1 defaults to GPIO10/11 which overlap I2S on this BSP;
            UART2+ with uart_set_pin to GPIO4/5 is the safer default.

    config UART_ESC_POS_PRINT_COLS
        int "Text strip columns (58mm Font B, CJK=2 cols/char)"
        default 42
        range 16 48
        help
            Font B on 58mm paper: ~42 ASCII or ~21 CJK chars per line.
            ASCII=1 col, CJK=2 cols. Lower for 48mm or Font A.

    config ESC_POS_RASTER_BAND_HEIGHT
        int "GS v0 raster band height (dots)"
        default 24
        range 8 256

    config ESC_POS_RASTER_BAND_DELAY_MS
        int "Delay between GS v0 bands (ms, 0=none)"
        default 100
        range 0 5000

    config ESC_POS_RASTER_PAD_48
        bool "Pad last band +8 rows when height multiple of 48"
        default n

    config ESC_POS_RASTER_FINISH_FEED_DOTS
        int "Safe finish ESC J feed dots"
        default 32
        range 0 255

    config BLE_ESC_POS_NAME_FILTER
        string "BLE thermal printer: match advertised name contains (optional)"
        default ""
        help
            Case-insensitive substring of the BLE advertised name.
            If empty, the firmware connects to the first peripheral that advertises the
            Nordic UART Service (NUS), which is common for BLE serial thermal printers.
            Dongwei UART printers use the same ESC/POS bytes; over BLE they are sent as
            writes to the NUS RX characteristic.

endmenu
```

## sdkconfig.defaults.release
```kconfig
# Release profile — merge with sdkconfig.defaults:
#   idf.py -DSDKCONFIG_DEFAULTS="sdkconfig.defaults;sdkconfig.defaults.release" build

# Log
CONFIG_LOG_DEFAULT_LEVEL_WARN=y
CONFIG_LOG_DEFAULT_LEVEL=2

# Bluetooth off (WiFi uses ESP-Hosted SDIO)
CONFIG_BT_ENABLED=n
CONFIG_BT_NIMBLE_ENABLED=n
CONFIG_ESP_HOSTED_ENABLE_BT_NIMBLE=n

# LVGL fonts — keep sizes used by Music UI + Brookesia
CONFIG_LV_FONT_MONTSERRAT_8=n
CONFIG_LV_FONT_MONTSERRAT_10=n
CONFIG_LV_FONT_MONTSERRAT_12=n
CONFIG_LV_FONT_MONTSERRAT_18=n
CONFIG_LV_FONT_MONTSERRAT_20=n
CONFIG_LV_FONT_MONTSERRAT_24=n
CONFIG_LV_FONT_MONTSERRAT_26=n
CONFIG_LV_FONT_MONTSERRAT_28=n
CONFIG_LV_FONT_MONTSERRAT_30=n
CONFIG_LV_FONT_MONTSERRAT_34=n
CONFIG_LV_FONT_MONTSERRAT_36=n
CONFIG_LV_FONT_MONTSERRAT_38=n
CONFIG_LV_FONT_MONTSERRAT_40=n
CONFIG_LV_FONT_MONTSERRAT_42=n
CONFIG_LV_FONT_MONTSERRAT_44=n
CONFIG_LV_FONT_MONTSERRAT_46=n
CONFIG_LV_FONT_MONTSERRAT_48=n
CONFIG_LV_FONT_MONTSERRAT_16=y
CONFIG_LV_FONT_MONTSERRAT_22=y
CONFIG_LV_FONT_MONTSERRAT_32=y

# LVGL demo/debug off
CONFIG_LV_USE_MONKEY=n
CONFIG_LV_USE_DEMO_WIDGETS=n
CONFIG_LV_USE_DEMO_BENCHMARK=n
CONFIG_LV_USE_DEMO_STRESS=n

# Size over speed for release flash budget
CONFIG_COMPILER_OPTIMIZATION_SIZE=y
CONFIG_COMPILER_OPTIMIZATION_PERF=n

# Runtime stats off
CONFIG_FREERTOS_GENERATE_RUN_TIME_STATS=n
CONFIG_FREERTOS_VTASKLIST_INCLUDE_COREID=n

# UART printer boot test off
CONFIG_UART_ESC_POS_BOOT_TEST=n

# AI detect models off
CONFIG_HUMAN_FACE_DETECT_MODEL_IN_FLASH_RODATA=n
CONFIG_PEDESTRIAN_DETECT_MODEL_IN_FLASH_RODATA=n

# RAM tuning
CONFIG_LV_LAYER_SIMPLE_BUF_SIZE=51200
CONFIG_LV_IMG_CACHE_DEF_SIZE=10
CONFIG_FREERTOS_TASK_CREATE_ALLOW_EXT_MEM=y

# Network
CONFIG_LWIP_TCP_RECVMBOX_SIZE=16
```
